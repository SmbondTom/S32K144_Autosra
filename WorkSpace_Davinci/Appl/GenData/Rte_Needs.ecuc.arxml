AUTOSAR XML (schema 4-0-3)
package /DaVinci_Project
  module config Rte
    6 x RteBswModuleInstance:
      BswM
        BswM_MainFunctionTimingEvent0 (RteBswEventToTaskMapping): RteBswUsedOsEventRef=Rte_Ev_Cyclic2_OsTask_Bsw_0_10ms, RteBswUsedOsAlarmRef=Os/Rte_Al_TE2_OsTask_Bsw_0_10ms
      Det
      Dio
      EcuM
        EcuM_MainFunctionTimingEvent0 (RteBswEventToTaskMapping): RteBswUsedOsEventRef=Rte_Ev_Cyclic2_OsTask_Bsw_0_10ms, RteBswUsedOsAlarmRef=Os/Rte_Al_TE2_OsTask_Bsw_0_10ms
      Mcu
      Port
    5 x RteSwComponentInstance:
      BswM_EcuSwComposition
        Timer_BswM_MainFunction (RteEventToTaskMapping): RteUsedOsEventRef=Rte_Ev_Cyclic2_OsTask_Bsw_0_10ms, RteUsedOsAlarmRef=Os/Rte_Al_TE2_OsTask_Bsw_0_10ms
      Det_EcuSwComposition
      EcuM_EcuSwComposition
        Timer_EcuM_MainFunction (RteEventToTaskMapping): RteUsedOsEventRef=Rte_Ev_Cyclic2_OsTask_Bsw_0_10ms, RteUsedOsAlarmRef=Os/Rte_Al_TE2_OsTask_Bsw_0_10ms
      Os_OsCore0_swc_EcuSwComposition
      Test_swc_EcuSwComposition
        TMT_Test_swc_10ms (RteEventToTaskMapping): RteUsedOsAlarmRef=Os/Rte_Al_TE_Test_swc_Test_swc_50ms
    RteOsInteraction
      Rte_Al_TE2_OsTask_Bsw_0_10ms (RteUsedOsActivation): RteExpectedActivationOffset=0, RteActivationOsAlarmRef=Os/Rte_Al_TE2_OsTask_Bsw_0_10ms, RteActivationOsTaskRef=OsTask_Bsw
      Rte_Al_TE_Test_swc_Test_swc_50ms (RteUsedOsActivation): RteExpectedActivationOffset=0, RteActivationOsAlarmRef=Os/Rte_Al_TE_Test_swc_Test_swc_50ms, RteActivationOsTaskRef=OsTask_swc_Task
  module config NvM
  module config Os
    OsTask_Bsw (OsTask): OsTaskActivation=1, OsTaskPriority=50, OsTaskSchedule=FULL, OsTaskEventRef=Rte_Ev_Cyclic2_OsTask_Bsw_0_10ms
    Rte_Al_TE2_OsTask_Bsw_0_10ms (OsAlarm): OsAlarmCounterRef=SystemTimer
      OsAlarmAction
        OsAlarmSetEvent: OsAlarmSetEventRef=Rte_Ev_Cyclic2_OsTask_Bsw_0_10ms, OsAlarmSetEventTaskRef=OsTask_Bsw
    OsTask_swc_Init (OsTask): OsTaskActivation=1, OsTaskPriority=0, OsTaskSchedule=FULL
    OsTask_swc_Task (OsTask): OsTaskActivation=1, OsTaskPriority=0, OsTaskSchedule=FULL
    Rte_Al_TE_Test_swc_Test_swc_50ms (OsAlarm): OsAlarmCounterRef=SystemTimer
      OsAlarmAction
        OsAlarmActivateTask: OsAlarmActivateTaskRef=OsTask_swc_Task
    Rte_Ev_Cyclic2_OsTask_Bsw_0_10ms (OsEvent)
  module config EcuC
  ecuc value collection DaVinci_Project: ecuc-values=[Com, Rte, Os, EcuC, NvM]

AUTOSAR XML (schema 00044)
package /ECUCompositionTypes
  composition sw component type ECU_Composition
    component Test_swc: type=Test_swc
package /EndToEndProtections
  end to end protection set EndToEndProtectionSet
package /Systems
  system Autosar_MinSystem
    root-software-compositions:
      root sw composition prototype EcuSwComposition: software-composition=ECU_Composition

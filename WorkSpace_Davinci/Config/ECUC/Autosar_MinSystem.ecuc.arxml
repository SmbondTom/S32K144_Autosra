AUTOSAR XML (schema 00045)
package /ActiveEcuC
  ecuc value collection ActiveEcuC: ecu-extract=SYSTEM, ecuc-values=[BswM, Det, EcuM, Os, Rte, vSet, EcuC, Resource, Base, Dio, Port, Mcu]

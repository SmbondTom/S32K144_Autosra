AUTOSAR XML (schema 4-0-3)
package /COM/VECTOR/CFG/WORKFLOW/SYSDESC/SYNC
  flat map FLATMAP
    flat instance descriptor Test_swc: upstream-reference=EcuSwComposition.Test_swc, ecu-extract-reference=COMPOSITIONTYPE.Test_swc
